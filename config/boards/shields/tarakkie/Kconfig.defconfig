## config/boards/shields/tarakkie/Kconfig.defconfig
```kconfig
## 一体型構成（分割しない）の場合の名称設定。
if SHIELD_TARAKKIE

config ZMK_KEYBOARD_NAME
    default "Tarakkie"

endif
```

## config/boards/shields/tarakkie/Kconfig.shield
```kconfig
# Copyright (c) 2025
# SPDX-License-Identifier: MIT
# 一体型（非分割）シールド有効化フラグ
# -DSHIELD=tarakkie を指定した場合にこの設定が有効になり分割関連の追加設定を使わず単体で動作します。
config SHIELD_TARAKKIE
    def_bool $(shields_list_contains,tarakkie)
```

## config/boards/shields/tarakkie_left/Kconfig.defconfig
```kconfig
# Copyright (c) 2025
# SPDX-License-Identifier: MIT

# 左手側シールドが選択された場合のみ以下の設定を適用します。
# 分割構成では左は peripheral（子）側として動作し、右 central が接続管理を担当します。
if SHIELD_TARAKKIE_LEFT

# BLE ペアリング一覧・ログ表示などに使われる識別名。好みに応じて変更可能。
config ZMK_KEYBOARD_NAME
    default "Tarakkie Left"

endif
```

## config/boards/shields/tarakkie_left/Kconfig.shield
```kconfig
# Copyright (c) 2025
# SPDX-License-Identifier: MIT
# 左手側シールド有効化フラグ
# west build 実行時に -DSHIELD=tarakkie_left を指定すると shields_list_contains が一致し true になります。
# true のときこのシールド用の overlay / keymap などがビルドへ取り込まれます。
config SHIELD_TARAKKIE_LEFT
    def_bool $(shields_list_contains,tarakkie_left)
```

## config/boards/shields/tarakkie_right/Kconfig.defconfig
```kconfig
# Copyright (c) 2025
# SPDX-License-Identifier: MIT

# 右手側が選択された場合の設定。右は Split の central（親）側で、左へ接続管理/BLE広告を行います。
if SHIELD_TARAKKIE_RIGHT

# BLE 等で表示される右手側名称。
config ZMK_KEYBOARD_NAME
    default "Tarakkie Right"

# central 役割フラグ: y でこのファームがホスト側になる。左側は implicit に peripheral。
config ZMK_SPLIT_ROLE_CENTRAL
    default y

endif
```

## config/boards/shields/tarakkie_right/Kconfig.shield
```kconfig
# Copyright (c) 2025
# SPDX-License-Identifier: MIT
# 右手側シールド有効化フラグ
# -DSHIELD=tarakkie_right を指定したビルドで true になり中央 (central) 側として振る舞う設定が読み込まれます。
config SHIELD_TARAKKIE_RIGHT
    def_bool $(shields_list_contains,tarakkie_right)
```

## drivers/Kconfig
```kconfig
# Copyright (c) 2024 ZMK Config with MCP23xxx driver backport
# SPDX-License-Identifier: Apache-2.0

# Source the MCP23xxx driver Kconfig
source "drivers/gpio/Kconfig.mcp23xxx"
```

## drivers/gpio/Kconfig.mcp23xxx
```kconfig
# MCP23XXX GPIO configuration options

# Copyright (c) 2021 metraTec GmbH
#
# SPDX-License-Identifier: Apache-2.0

config GPIO_MCP23XXX
	bool
	help
	  Enable support for the Microchip 23xxx I2C/SPI IO
	  expanders.

menuconfig GPIO_MCP230XX
	bool "MCP230XX I2C-based GPIO chip"
	default y
	depends on DT_HAS_MICROCHIP_MCP23008_ENABLED || \
	           DT_HAS_MICROCHIP_MCP23009_ENABLED || \
	           DT_HAS_MICROCHIP_MCP23016_ENABLED || \
	           DT_HAS_MICROCHIP_MCP23017_ENABLED || \
	           DT_HAS_MICROCHIP_MCP23018_ENABLED
	select I2C
	select GPIO_MCP23XXX
	help
	  Enable driver for MCP230XX I2C-based GPIO chip.

if GPIO_MCP230XX

config GPIO_MCP230XX_INIT_PRIORITY
	int "MCP230XX GPIO expander init priority"
	default 75
	help
	  Device driver initialization priority.

endif #GPIO_MCP230XX
```
